//////////////////////////////////////////////////////////////////////////////////	 
//本程序只供学习使用，未经作者许可，不得用于其它任何用途
//测试硬件：STC51
//1.8寸TFT_ST7735液晶驱动
//********************************************************************************
//V1.1修改说明
//加入横屏显示代码，直接在初始化中切换横竖屏模式
//////////////////////////////////////////////////////////////////////////////////
#include "main.h"
#include "intrins.h"
#include "lcd.h"
#include "spi_flash.h"
#include "saveconfigfile.h"
#include <string.h>

#define USE_LANDSCAPE//测试程序横竖屏切换，横屏请开启此宏，竖屏请屏蔽
#define nopsw _nop_(); //_nop_();_nop_();_nop_();_nop_();_nop_();_nop_();_nop_();

//---------------------------液晶屏接线说明-------------------------------------//
//接线前请参考液晶屏说明书第10页引脚定义
sbit bl        =P3^4;//接模块BL引脚，背光可以采用IO控制或者PWM控制，也可以直接接到高电平常亮
sbit scl       =P1^2;//接模块CLK引脚,接裸屏Pin9_SCL
sbit sda       =P1^3;//接模块DIN/MOSI引脚，接裸屏Pin8_SDA
sbit rs        =P1^5;//接模块D/C引脚，接裸屏Pin7_A0
sbit cs        =P3^5;//接模块CE引脚，接裸屏Pin12_CS
sbit reset     =P1^4;//接模块RST引脚，接裸屏Pin6_RES
//---------------------------End of液晶屏接线---------------------------------//



//向SPI总线传输一个8位数据
void  SPI_WriteData(uchar Data2)
{
	unsigned char i=0;
	for(i=8;i>0;i--)
	{
		if(Data2&0x80)	
		sda=1; //输出数据
		else sda=0;
		nopsw;
		scl=0;
		nopsw;
		scl=1;
		Data2<<=1;
	}
}
//向液晶屏写一个8位指令
void  Lcd_WriteIndex(uchar Data2)
{
		
		cs=0;
		rs=0;
		SPI_WriteData(Data2); 		
		cs=1;
}
//向液晶屏写一个8位数据
void  Lcd_WriteData(uchar Data2)
{	
		unsigned char i=0;
		cs=0;
		rs=1;
		SPI_WriteData(Data2); 	
		cs=1;
}
//向液晶屏写一个16位数据
void  LCD_WriteData_16Bit(unsigned int Data2)
{
	unsigned char i=0;
	cs=0;
	rs=1;
	SPI_WriteData(Data2>>8); 	//写入高8位数据
	SPI_WriteData(Data2); 			//写入低8位数据
	cs=1;

}

void LCD_Reset()
{
    reset=0;
    delay_ms(100);
    reset=1;
    delay_ms(100);
}


void CtrlLcdBL(u8 cl)
{
	if (cl==1) bl=1;
	else bl=0;
}


//////////////////////////////////////////////////////////////////////////////////////////////
//液晶屏初始化 for S6D02A1
void lcd_initial()
{	
	LCD_Reset();//Reset before LCD Init.	
	//LCD Init For 1.44Inch LCD Panel with ST7735R.
	Lcd_WriteIndex(0x11);//Sleep exit 
	delay_ms (120);
		
	//ST7735R Frame Rate
	Lcd_WriteIndex(0xB1); 
	Lcd_WriteData(0x01); 
	Lcd_WriteData(0x2C); 
	Lcd_WriteData(0x2D); 

	Lcd_WriteIndex(0xB2); 
	Lcd_WriteData(0x01); 
	Lcd_WriteData(0x2C); 
	Lcd_WriteData(0x2D); 

	Lcd_WriteIndex(0xB3); 
	Lcd_WriteData(0x01); 
	Lcd_WriteData(0x2C); 
	Lcd_WriteData(0x2D); 
	Lcd_WriteData(0x01); 
	Lcd_WriteData(0x2C); 
	Lcd_WriteData(0x2D); 
	
	Lcd_WriteIndex(0xB4); //Column inversion 
	Lcd_WriteData(0x07); 
	
	//ST7735R Power Sequence
	Lcd_WriteIndex(0xC0); 
	Lcd_WriteData(0xA2); 
	Lcd_WriteData(0x02); 
	Lcd_WriteData(0x84); 
	Lcd_WriteIndex(0xC1); 
	Lcd_WriteData(0xC5); 

	Lcd_WriteIndex(0xC2); 
	Lcd_WriteData(0x0A); 
	Lcd_WriteData(0x00); 

	Lcd_WriteIndex(0xC3); 
	Lcd_WriteData(0x8A); 
	Lcd_WriteData(0x2A); 
	Lcd_WriteIndex(0xC4); 
	Lcd_WriteData(0x8A); 
	Lcd_WriteData(0xEE); 
	
	Lcd_WriteIndex(0xC5); //VCOM 
	Lcd_WriteData(0x0E); 
	
	Lcd_WriteIndex(0x36); //MX, MY, RGB mode 
//	Lcd_WriteData(0xC0); 
#ifdef USE_LANDSCAPE
	Lcd_WriteData(0x68); //竖屏C8 横屏08 A8
#else
	Lcd_WriteData(0xC8); //竖屏C8 横屏08 A8
#endif		*/
	//ST7735R Gamma Sequence
	Lcd_WriteIndex(0xe0); 
	Lcd_WriteData(0x0f); 
	Lcd_WriteData(0x1a); 
	Lcd_WriteData(0x0f); 
	Lcd_WriteData(0x18); 
	Lcd_WriteData(0x2f); 
	Lcd_WriteData(0x28); 
	Lcd_WriteData(0x20); 
	Lcd_WriteData(0x22); 
	Lcd_WriteData(0x1f); 
	Lcd_WriteData(0x1b); 
	Lcd_WriteData(0x23); 
	Lcd_WriteData(0x37); 
	Lcd_WriteData(0x00); 	
	Lcd_WriteData(0x07); 
	Lcd_WriteData(0x02); 
	Lcd_WriteData(0x10); 

	Lcd_WriteIndex(0xe1); 
	Lcd_WriteData(0x0f); 
	Lcd_WriteData(0x1b); 
	Lcd_WriteData(0x0f); 
	Lcd_WriteData(0x17); 
	Lcd_WriteData(0x33); 
	Lcd_WriteData(0x2c); 
	Lcd_WriteData(0x29); 
	Lcd_WriteData(0x2e); 
	Lcd_WriteData(0x30); 
	Lcd_WriteData(0x30); 
	Lcd_WriteData(0x39); 
	Lcd_WriteData(0x3f); 
	Lcd_WriteData(0x00); 
	Lcd_WriteData(0x07); 
	Lcd_WriteData(0x03); 
	Lcd_WriteData(0x10);  
	
	Lcd_WriteIndex(0x2a);
	Lcd_WriteData(0x00);
	Lcd_WriteData(0x02);
	Lcd_WriteData(0x02);
	Lcd_WriteData(0x80+2);

	Lcd_WriteIndex(0x2b);
	Lcd_WriteData(0x00);
	Lcd_WriteData(0x00+3);
	Lcd_WriteData(0x00);
	Lcd_WriteData(0xA0+3);
	
	Lcd_WriteIndex(0xF0); //Enable test command  
	Lcd_WriteData(0x01); 
	Lcd_WriteIndex(0xF6); //Disable ram power save mode 
	Lcd_WriteData(0x00); 
	
	Lcd_WriteIndex(0x3A); //65k mode 
	Lcd_WriteData(0x05); 
	
	Lcd_WriteIndex(0x29);//Display on

	CtrlLcdBL(0);
}



/*************************************************
函数名：LCD_Set_Region
功能：设置lcd显示区域，在此区域写点数据自动换行
入口参数：xy起点和终点
返回值：无
*************************************************/
void Lcd_SetRegion(unsigned int x_start,unsigned int y_start,unsigned int x_end,unsigned int y_end)
{	

//#ifdef USE_LANDSCAPE//使用横屏模式
	Lcd_WriteIndex(0x2a);
	Lcd_WriteData(0x0);
	Lcd_WriteData(x_start);
	Lcd_WriteData(0x00);
	Lcd_WriteData(x_end);

	Lcd_WriteIndex(0x2b);
	Lcd_WriteData(0x0);
	Lcd_WriteData(y_start);
	Lcd_WriteData(0x0);
	Lcd_WriteData(y_end);
/*
#else//竖屏模式	
	Lcd_WriteIndex(0x2a);
	Lcd_WriteData(0x02);
	Lcd_WriteData(x_start+2);
	Lcd_WriteData(0x02);
	Lcd_WriteData(x_end+2);

	Lcd_WriteIndex(0x2b);
	Lcd_WriteData(0x01);
	Lcd_WriteData(y_start+1);
	Lcd_WriteData(0x01);
	Lcd_WriteData(y_end+1);	
#endif
*/
	Lcd_WriteIndex(0x2c);
}


void LCD_Clear(u16 color)
{
 	u8 i,j;
	Lcd_SetRegion(0,0,130,132);
 	for (i=0;i<130;i++)
    	for (j=0;j<132;j++)
        	LCD_WriteData_16Bit(color);
}

void PutPixel(u8 x_start,u8 y_start,u16 color)
{
	Lcd_SetRegion(x_start,y_start,x_start+1,y_start+1);
	LCD_WriteData_16Bit(color);
	
}


/*****************************************************************************
 * @name       :void Gui_Drawbmp16(u16 x,u16 y,const unsigned char *p)
 * @date       :2018-08-09 
 * @function   :Display a 16-bit BMP image
 * @parameters :x:the bebinning x coordinate of the BMP image
                y:the bebinning y coordinate of the BMP image
								p:the start address of image array
 * @retvalue   :None
******************************************************************************/ 
void Gui_Drawbmp16(u8 x,u8 y,const unsigned char *p) //显示图片
{
  u16 Ki; 
	unsigned char picW,picH; 
	u16 sendv;
	PICHEADBYTE* picHead=  (PICHEADBYTE*) p;
	p+=sizeof(PICHEADBYTE);
	picW=picHead->wl;
	picH=picHead->hl;
	Lcd_SetRegion(x,y,x+picW-1,y+picH-1);//窗口设置
	Ki=picW*picH;
  while (Ki>0)
	{	
		sendv=*(p+1);	
		sendv=sendv<<8;
	 	sendv|=*(p);	//数据低位在前
		LCD_WriteData_16Bit(sendv);  		
		p+=2;
		Ki--;
	}	
//	Lcd_SetRegion(0,0,LCD_W-1,LCD_H-1);//恢复显示窗口为全屏	
}



/*****************************************************************************
 * @name       :void Gui_Drawbmp16(u16 x,u16 y,const unsigned char *p)
 * @date       :2018-08-09 
 * @function   :Display a 16-bit BMP image
 * @parameters :x:the bebinning x coordinate of the BMP image
                y:the bebinning y coordinate of the BMP image
								p:the start address of image array
 * @retvalue   :None
******************************************************************************/ 
void Gui_DrawFlashbmp16(u8 x,u8 y,u32 FlashAddr) //显示Flash图片
{
	u8 flashdata[256];
	unsigned char *p;
	u16 picSize;
	u16 sendvty;
	u16 sendN;
	PICHEADBYTE picHead;
	SPI_FLASH_BufferRead(&(picHead.scan),FlashAddr,sizeof(PICHEADBYTE));

	if (picHead.wl>128 || picHead.hl>128) return;
	
	FlashAddr+=sizeof(PICHEADBYTE);
	picSize=picHead.wl*picHead.hl*2;
	
	Lcd_SetRegion(x,y,x+picHead.wl-1,y+picHead.hl-1);//窗口设置
	
	while(picSize>0)
	{
		if (picSize>256)
			{
			sendN=256- (FlashAddr&0xff);
			SPI_FLASH_BufferRead(flashdata,FlashAddr,sendN);
			FlashAddr+=sendN;
			picSize-=sendN;
			}
		else 
			{
			sendN=picSize;	
			SPI_FLASH_BufferRead(flashdata,FlashAddr,picSize);
			picSize=0;
			}

		p=flashdata;
		while (sendN>0)
		{	
			sendvty=*(p+1);	
			sendvty=sendvty<<8;
			sendvty|=(*(p));	//数据低位在前
			LCD_WriteData_16Bit(sendvty);  		
			p+=2;
			sendN-=2;
		}	
	}
}


//显示一个英文字符
void Display_ASCII8X16(u8 x0,u8 y0,uchar *s,u8 strglen,u16 color)
{
	u8 i,j,k,x,y,xx;
	
	unsigned char qm;
	
	u16 ulOffset;
	
	char  ywbuf[32];

	for(i = 0; i<strglen;i++)
	{
		if(((unsigned char)(*(s+i))) >= 161)
		{
			return;
		}
		
		else
		{
			qm = *(s+i);

			ulOffset = (u16)(qm) <<4;
			
      for (j = 0; j < 16; j ++)
      {
				ywbuf[j]=Zk_ASCII8X16[ulOffset+j];
      }
             
      for(y = 0;y < 16;y++)
      {
	        for(x=0;x<8;x++) 
	        {
             k=x &0x07;
                	
				  	if(ywbuf[y]&(0x80 >> k))
				   	{
				  		xx=x0+x+(i<<3);
				    	PutPixel(xx,y+y0,color);
				  	}
							
			   	}
      }

		}
	}     	
}



/*******************************************************************
 * @name       :void LCD_Fill(u16 sx,u16 sy,u16 ex,u16 ey,u16 color)
 * @date       :2018-08-09 
 * @function   :fill the specified area
 * @parameters :sx:the bebinning x coordinate of the specified area
                sy:the bebinning y coordinate of the specified area
								ex:the ending x coordinate of the specified area
								ey:the ending y coordinate of the specified area
								color:the filled color value
 * @retvalue   :None
********************************************************************/
void LCD_Fill(u16 sx,u16 sy,u16 ex,u16 ey,u16 color)
{  	
	u16 i,j;			
	u16 width=ex-sx+1; 		//得到填充的宽度
	u16 height=ey-sy+1;		//高度
	Lcd_SetRegion(sx,sy,ex,ey);//设置显示窗口
	for(i=0;i<height;i++)
	{
		for(j=0;j<width;j++)
		LCD_WriteData_16Bit(color);	//写入数据 	 
	}
}

/*******************************************************************
 * @name       :void LCD_DrawLine(u16 x1, u16 y1, u16 x2, u16 y2)
 * @date       :2018-08-09 
 * @function   :Draw a line between two points
 * @parameters :x1:the bebinning x coordinate of the line
                y1:the bebinning y coordinate of the line
								x2:the ending x coordinate of the line
								y2:the ending y coordinate of the line
 * @retvalue   :None
********************************************************************/
void LCD_DrawLine(u16 x1, u16 y1, u16 x2, u16 y2,u16 color)
{
	u16 t; 
	int xerr=0,yerr=0,delta_x,delta_y,distance; 
	int incx,incy,uRow,uCol; 

	delta_x=x2-x1; //计算坐标增量 
	delta_y=y2-y1; 
	uRow=x1; 
	uCol=y1; 
	if(delta_x>0)incx=1; //设置单步方向 
	else if(delta_x==0)incx=0;//垂直线 
	else {incx=-1;delta_x=-delta_x;} 
	if(delta_y>0)incy=1; 
	else if(delta_y==0)incy=0;//水平线 
	else{incy=-1;delta_y=-delta_y;} 
	if( delta_x>delta_y)distance=delta_x; //选取基本增量坐标轴 
	else distance=delta_y; 
	for(t=0;t<=distance+1;t++ )//画线输出 
	{  
		PutPixel(uRow,uCol,color);//画点 
		xerr+=delta_x ; 
		yerr+=delta_y ; 
		if(xerr>distance) 
		{ 
			xerr-=distance; 
			uRow+=incx; 
		} 
		if(yerr>distance) 
		{ 
			yerr-=distance; 
			uCol+=incy; 
		} 
	}  
} 

/*****************************************************************************
 * @name       :void LCD_DrawRectangle(u16 x1, u16 y1, u16 x2, u16 y2)
 * @date       :2018-08-09 
 * @function   :Draw a rectangle
 * @parameters :x1:the bebinning x coordinate of the rectangle
                y1:the bebinning y coordinate of the rectangle
								x2:the ending x coordinate of the rectangle
								y2:the ending y coordinate of the rectangle
 * @retvalue   :None
******************************************************************************/
void LCD_DrawRectangle(u16 x1, u16 y1, u16 x2, u16 y2,u16 color)
{
	LCD_DrawLine(x1,y1,x2,y1,color);
	LCD_DrawLine(x1,y1,x1,y2,color);
	LCD_DrawLine(x1,y2,x2,y2,color);
	LCD_DrawLine(x2,y1,x2,y2,color);
}  

void UpdateLCDLEDSelected(u8 chN, u8 Selected)
{
	u8 Rw=18,Rh=100;
	u8 Rx,Ry=5,RWh=110;
	u8 Dxw=LCD_W /SaveLedData0.LedALLChanels;
	if (chN==0) return;

	Rx =((Dxw-20)>>1)+Dxw*(chN-1)+1;
	if (Selected) LCD_DrawRectangle(Rx-7,RWh-1,Rx+27,RWh+16,BLACK);
	else LCD_DrawRectangle(Rx-7,RWh-1,Rx+27,RWh+16,BACKGROUNDCOLOR);
}

void UpdateLCDLEDCloum(u8 chN, u8 Power, u8 onoff)
{
	u8 Rw=18,Rh=100;
	u8 Rx,Ry=5;
	u8 Dxw=LCD_W /SaveLedData0.LedALLChanels;
	u16 color;
	if (chN==0) return;
	
	 if (chN==1) color=PURPLE;
	 else if (chN==2) color=BLUE;
	 else if (chN==3) color=GREEN;
	 else color=RED;
	 
	Rx =((Dxw-20)>>1)+Dxw*(chN-1)+1;
	//填框
	LCD_Fill(Rx,Ry,Rx+Rw,Ry+Rh-Power,BACKGROUNDCOLOR);
	if (onoff) 
		LCD_Fill(Rx,Ry+Rh-Power,Rx+Rw,Rh+Ry,color);
	else
		LCD_Fill(Rx,Ry+Rh-Power,Rx+Rw,Rh+Ry,GRAY);
}


void UpdateLcdPowerDisplay(u8 chN, u8 Power,u8 onoff)
{
	 u8 Rw=18,Rh=100;
	 u8 Rx,Ry=5,RWh=110;
	 u8 NumberStr[4];
	 u8 Dxw=LCD_W /SaveLedData0.LedALLChanels;
	 if (chN==0) return;
	Rx =((Dxw-20)>>1)+Dxw*(chN-1)+1;
	//填框
	UpdateLCDLEDCloum( chN,  Power,onoff);
	

//清除数字显示
	LCD_Fill(Rx-6,RWh,Rx+26,RWh+15,BACKGROUNDCOLOR);
//	if (Selected) LCD_DrawRectangle(Rx-9,RWh-1,Rx+38,RWh+18,BLACK);
	
	if (Power==100)
		{
		Rx-=6;
		NumberStr[0]='1';
		NumberStr[1]='0';
		NumberStr[2]='0';
		NumberStr[3]='%';
		Display_ASCII8X16(Rx,RWh,NumberStr,4,BLACK);
		}
	else if (Power>=10) 
		{
		NumberStr[0]='0'+Power/10;  
		NumberStr[1]='0'+Power%10;
		NumberStr[2]='%';
		Display_ASCII8X16(Rx,RWh,NumberStr,3,BLACK);
		}
	else 
		{
		NumberStr[0]='0'+Power%10;
		NumberStr[1]='%';
		Display_ASCII8X16(Rx,RWh,NumberStr,2,BLACK);
		}
}

void LCD_DrawWorkScreen(void)
{
 u8 Rw=20,Rh=102;
 u8 Rx,Ry=4;
 u8 Dxw=LCD_W /SaveLedData0.LedALLChanels; 
 u8 onoff=0;
	LCD_Clear(BACKGROUNDCOLOR);
	Rx =(Dxw-Rw)>>1;
	LCD_DrawRectangle(Rx,Ry,Rx+Rw,Rh+Ry,PURPLE);
	if (SaveLedData0.SelectedLedChanel==1 && SaveLedData0.LedOnOff==1) onoff=1;else onoff=0;
	UpdateLcdPowerDisplay(1, SaveLedData0.LedPower[1],onoff);
	if (SaveLedData0.LedALLChanels>=2)
		{
		Rx +=Dxw;
		LCD_DrawRectangle(Rx,4,Rx+Rw,Rh+4,BLUE);
		if (SaveLedData0.SelectedLedChanel==2 && SaveLedData0.LedOnOff==1) onoff=1;else onoff=0;
		UpdateLcdPowerDisplay(2, SaveLedData0.LedPower[2],onoff);
		if (SaveLedData0.LedALLChanels>=3)
			{
			Rx +=Dxw;
			LCD_DrawRectangle(Rx,4,Rx+Rw,Rh+4,GREEN);
			if (SaveLedData0.SelectedLedChanel==3 && SaveLedData0.LedOnOff==1) onoff=1;else onoff=0;
			UpdateLcdPowerDisplay(3, SaveLedData0.LedPower[3],onoff);
			
			
			if (SaveLedData0.LedALLChanels>=4)
				{
				Rx +=Dxw;
				LCD_DrawRectangle(Rx,4,Rx+Rw,Rh+4,RED);
				if (SaveLedData0.SelectedLedChanel==4 && SaveLedData0.LedOnOff==1) onoff=1;else onoff=0;
				UpdateLcdPowerDisplay(4, SaveLedData0.LedPower[4],onoff);
				}
			}
		}

	if (SaveLedData0.SelectedLedChanel==1)
	{
	UpdateLCDLEDSelected(1,1);
	}
	else if (SaveLedData0.SelectedLedChanel==2)
	{
	UpdateLCDLEDSelected(2,1);
	}
	else if (SaveLedData0.SelectedLedChanel==3)
	{
	UpdateLCDLEDSelected(3,1);
	}
	else if (SaveLedData0.SelectedLedChanel==4)
	{
	UpdateLCDLEDSelected(4,1);
	}
	LCD_DISPiD=1;
}

void DisplayDisconnect(void)
{
	LCD_Clear(BACKGROUNDCOLOR);
	LCD_DrawRectangle(5,5,123,123,BLACK);
	Display_ASCII8X16(33,16,"Warnning",8,RED);
	Display_ASCII8X16(13,48,"Driver board",12,RED);
	Display_ASCII8X16(13,64,"disconnect!",11,RED);
	LCD_DISPiD=0xff;
}

void DispSettingRectangle(void)
{
	LCD_DrawRectangle(95,7+(LCD_DISPiD-3)*20,126,25+(LCD_DISPiD-3)*20,BACKGROUNDCOLOR);
	LCD_DrawRectangle(95,7+(LCD_DISPiD-2)*20,126,25+(LCD_DISPiD-2)*20,BLACK);
}

void DispSettingRectangle2(void)
{
	u8 tempv=LCD_DISPiD-6;
	LCD_DrawRectangle(95,7+(tempv-3)*20,126,25+(tempv-3)*20,BACKGROUNDCOLOR);
	LCD_DrawRectangle(95,7+(tempv-2)*20,126,25+(tempv-2)*20,BLACK);
}


void DispSettingNumber(u8 location,u8 numberv)
{
	u8 Num[3];
	u8 y;
	y=8+20*(location-2);
	//清除数字显示
	LCD_Fill(95,y,126,y+16,BACKGROUNDCOLOR);
	Num[0]='0'+numberv/100;
	Num[1]='0'+numberv%100/10;
	Num[2]='0'+numberv%10;
	Display_ASCII8X16(96,y,Num,3,BLACK);
}


void DisplaySetting(void)
{

	LCD_DISPiD=2;
	LCD_Clear(BACKGROUNDCOLOR);
	Display_ASCII8X16(8,8,"LED Number:",11,BLACK);
	DispSettingNumber(2,SaveLedData0.LedALLChanels);
	LCD_DrawRectangle(95,7,126,25,BLACK);

	Display_ASCII8X16(8,28,"MotorStep:",10,BLACK);
	DispSettingNumber(3,SaveLedData0.MotorStepPluses);

	Display_ASCII8X16(8,48,"LED1 Lot:",9,BLACK);
	DispSettingNumber(4,SaveLedData0.LEDMotorLocation[1]);
	
	Display_ASCII8X16(8,68,"LED2 Lot:",9,BLACK);
	DispSettingNumber(5,SaveLedData0.LEDMotorLocation[2]);


	Display_ASCII8X16(8,88,"LED3 Lot:",9,BLACK);
	DispSettingNumber(6,SaveLedData0.LEDMotorLocation[3]);
	
	Display_ASCII8X16(8,108,"LED4 Lot:",9,BLACK);
	DispSettingNumber(7,SaveLedData0.LEDMotorLocation[4]);

	
}

void DisplaySetting2(void)
{

	LCD_DISPiD=8;
	LCD_Clear(BACKGROUNDCOLOR);
	Display_ASCII8X16(8,8,"Driver Fan:",11,BLACK);
	DispSettingNumber(2,SaveLedData0.DriverFanOnOff);
	LCD_DrawRectangle(95,7,126,25,BLACK);
}


#if 1


uchar code Zk_ASCII8X16[]=
 {
  0x00,0x00,0x00,0x00,0x00,0x00,0x00,0x00,0x00,0x00,0x00,0x00,0x00,
  0x00,0x00,0x00,0x00,0x00,0x00,0x00,0x00,0x00,0x00,0x00,0x00,0x00,
  0x00,0x00,0x00,0x00,0x00,0x00,0x00,0x00,0x00,0x00,0x00,0x00,0x00,
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  0x00,0x00,0x00,0x00,0x00,0x00,0x00,0x00,0x00,0x00,0x00,0x00,0x00
  };



#endif

